## build/conf/bblayers.conf
```bitbake
# POKY_BBLAYERS_CONF_VERSION is increased each time build/conf/bblayers.conf
# changes incompatibly
POKY_BBLAYERS_CONF_VERSION = "2"

BBPATH = "${TOPDIR}"
BBFILES ?= ""

BBLAYERS ?= " \
  /home/ms/dev/octoprint/poky/meta \
  /home/ms/dev/octoprint/poky/meta-poky \
  /home/ms/dev/octoprint/meta-openembedded/meta-oe \
  /home/ms/dev/octoprint/meta-raspberrypi \
  "
```
